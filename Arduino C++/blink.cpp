// generated by mBlock5 for mBot
// codes make you happy

#include <MeMCore.h>
#include <Arduino.h>
#include <Wire.h>
#include <SoftwareSerial.h>

MeRGBLed rgbled_7(7, 2);
MeBuzzer buzzer;

float soundDuration = 0;
float silenceDuration = 0;
float currentPitch = 0;
float numberOfBeeps = 0;
float numberOfBlinks = 0;
float redIntensity = 0;
float greenIntensity = 0;
float blueIntensity = 0;
float currentRedIntensity = 0;
float currentGreenIntensity = 0;
float currentBlueIntensity = 0;
float color = 0;
float onDuration = 0;
float offDuration = 0;

void Blink_S_N_N_S(String temperature, double tempo, double duration, String intensityChange){
  if(temperature == "Warm"){
    color = random(1, 2 +1);
    if(color == 2.000000){
      redIntensity = 255;
      greenIntensity = 0;
      blueIntensity = 0;

    }
    if(color == 1.000000){
      redIntensity = 255;
      greenIntensity = 255;
      blueIntensity = 0;

    }

  }
  if(temperature == "Cool"){
    color = random(1, 2 +1);
    if(color == 2.000000){
      redIntensity = 0;
      greenIntensity = 255;
      blueIntensity = 0;

    }
    if(color == 1.000000){
      redIntensity = 0;
      greenIntensity = 0;
      blueIntensity = 255;

    }

  }
  if(duration * tempo > 1){
    numberOfBlinks = round((duration * tempo));

  }else{
    numberOfBlinks = 1;

  }
  offDuration = (1 / tempo) * 0.5;
  onDuration = ((1 / tempo - offDuration));
  for(int count=0;count<int(numberOfBlinks);count++){
    if(intensityChange == "Flat"){

      rgbled_7.setColor(0, redIntensity, greenIntensity, blueIntensity);
      rgbled_7.show();
      _delay(float(onDuration));

      rgbled_7.setColor(0, 0, 0, 0);
      rgbled_7.show();
      _delay(float(offDuration));

    }
    if(intensityChange == "Rising"){
      currentRedIntensity = 0;
      currentGreenIntensity = 0;
      currentBlueIntensity = 0;
      SmoothTurnOnLights_N(2 * (onDuration / 255));

    }
    if(intensityChange == "Falling"){
      currentRedIntensity = 0;
      currentGreenIntensity = 0;
      currentBlueIntensity = 0;
      SmoothTurnOffLights_N(2 * (onDuration / 255));

    }
    if(intensityChange == "Rising-Falling"){
      currentRedIntensity = 0;
      currentGreenIntensity = 0;
      currentBlueIntensity = 0;
      SmoothTurnOnLights_N(onDuration / 255);
      SmoothTurnOffLights_N(onDuration / 255);

    }
    if(intensityChange == "Falling-Rising"){
      currentRedIntensity = 0;
      currentGreenIntensity = 0;
      currentBlueIntensity = 0;
      SmoothTurnOffLights_N(onDuration / 255);
      SmoothTurnOnLights_N(onDuration / 255);

    }
  }

}
void SmoothTurnOnLights_N(double stepDuration){
  while(!((currentRedIntensity == redIntensity)  &&  ((currentGreenIntensity == greenIntensity)  &&  (currentBlueIntensity == blueIntensity))))
  {
    _loop();

    rgbled_7.setColor(0, currentRedIntensity, currentGreenIntensity, currentBlueIntensity);
    rgbled_7.show();
    if(!((currentRedIntensity == redIntensity))){
      currentRedIntensity += 1;

    }
    if(!((currentGreenIntensity == greenIntensity))){
      currentGreenIntensity += 1;

    }
    if(!((currentBlueIntensity == blueIntensity))){
      currentBlueIntensity += 1;

    }
    _delay(float(stepDuration));

  }

}
void SmoothTurnOffLights_N(double stepDuration){
  while(!((currentRedIntensity == 0.000000)  &&  ((currentGreenIntensity == 0.000000)  &&  (currentBlueIntensity == 0.000000))))
  {
    _loop();

    rgbled_7.setColor(0, currentRedIntensity, currentGreenIntensity, currentBlueIntensity);
    rgbled_7.show();
    if(!((currentRedIntensity == 0.000000))){
      currentRedIntensity += -1;

    }
    if(!((currentGreenIntensity == 0.000000))){
      currentGreenIntensity += -1;

    }
    if(!((currentBlueIntensity == 0.000000))){
      currentBlueIntensity += -1;

    }
    _delay(float(stepDuration));

  }

  rgbled_7.setColor(0, 0, 0, 0);
  rgbled_7.show();

}
void Beep_N_N_N_S(double pitch, double tempo, double duration, String intonation){
  if(duration * tempo > 1){
    numberOfBeeps = round((duration * tempo));

  }else{
    numberOfBeeps = 1;

  }
  silenceDuration = (1 / tempo) * 0.5;
  soundDuration = ((1 / tempo - silenceDuration));
  for(int count8=0;count8<int(numberOfBeeps);count8++){
    if(intonation == "Flat"){

      buzzer.tone(pitch, soundDuration * 1000);
      _delay(float(silenceDuration));

    }
    if(intonation == "Rising"){
      currentPitch = ((pitch - 100));
      for(int count2=0;count2<400;count2++){

        buzzer.tone(currentPitch, soundDuration / 200 * 1000);
        currentPitch = (currentPitch + 0.5);
      }

    }
    if(intonation == "Falling"){
      currentPitch = (pitch + 100);
      for(int count3=0;count3<400;count3++){

        buzzer.tone(currentPitch, soundDuration / 200 * 1000);
        currentPitch = ((currentPitch - 0.5));
      }

    }
    if(intonation == "Rising-Falling"){
      currentPitch = ((pitch - 100));
      for(int count4=0;count4<400;count4++){

        buzzer.tone(currentPitch, soundDuration / 400 * 1000);
        currentPitch = (currentPitch + 0.5);
      }
      for(int count5=0;count5<400;count5++){

        buzzer.tone(currentPitch, soundDuration / 400 * 1000);
        currentPitch = ((currentPitch - 0.5));
      }

    }
    if(intonation == "Falling-Rising"){
      currentPitch = (pitch + 100);
      for(int count6=0;count6<400;count6++){

        buzzer.tone(currentPitch, soundDuration / 400 * 1000);
        currentPitch = ((currentPitch - 0.5));
      }
      for(int count7=0;count7<400;count7++){

        buzzer.tone(currentPitch, soundDuration / 400 * 1000);
        currentPitch = (currentPitch + 0.5);
      }

    }
  }

}

void _delay(float seconds) {
  long endTime = millis() + seconds * 1000;
  while(millis() < endTime) _loop();
}

void setup() {
  rgbled_7.fillPixelsBak(0, 2, 1);
  Beep_N_N_N_S(500, 1, 2, "Rising");

}

void _loop() {
}

void loop() {
  _loop();
}

